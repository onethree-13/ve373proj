#include <Arduino.h>
#include <SPI.h>
#include <U8g2lib.h>
#include <Wire.h>
#include <SoftwareSerial.h>

SoftwareSerial mySerial(10, 11); // RX, TX

 //U8G2_ST75256_JLX256160_1_4W_SW_SPI u8g2(U8G2_R0, /* clock=*/ 52, /* data=*/ 51, /* cs=*/ 53, /* dc=*/ 9, /* reset=*/ 8);
/* https://www.mouser.com/catalog/specsheets/ArduinoBoardMega2560.pdf */
U8G2_ST75256_JLX256160_F_HW_I2C u8g2(U8G2_MIRROR, /*clock=*/21,  /*data = */ 20, /*reset=*/ 8);


#define mapElement_w 20
#define mapElement_h 20

static uint8_t tank1_left[] = {
  0x00, 0x00, 0x00,
  0x00, 0x00, 0x00,
  0x00, 0x00, 0x00,
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  0x00, 0x00, 0x00,
};

static uint8_t tank2_left[] = {
  0x00, 0x00, 0x00,
  0x00, 0x00, 0x00,
  0x00, 0x00, 0x00,
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  0x00, 0x00, 0x00,
};

static uint8_t tank1_right[] = {
  0x00, 0x00, 0x00,
  0x00, 0x00, 0x00,
  0x00, 0x00, 0x00,
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  0x00, 0x00, 0x00, 
};

static uint8_t tank2_right[] = {
  0x00, 0x00, 0x00,
  0x00, 0x00, 0x00,
  0x00, 0x00, 0x00,
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  0x00, 0x00, 0x00,
};

static uint8_t tank1_up[] = {
  0x00, 0x06, 0x00,
  0x00, 0x06, 0x00,
  0x00, 0x06, 0x00,
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  0x38, 0xc0, 0x01,
};

static uint8_t tank2_up[] = {
  0x00, 0x06, 0x00,
  0x00, 0x06, 0x00,
  0x00, 0x06, 0x00,
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  0x38, 0xc0, 0x01,
};

static uint8_t tank1_down[] = {
  0x38, 0xc0, 0x01,
  0x38, 0xc0, 0x01,
  0xf8, 0xff, 0x01,
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  0x00, 0x06, 0x00,
};

static uint8_t tank2_down[] = {
  0x38, 0xc0, 0x01,
  0x38, 0xc0, 0x01,
  0xf8, 0xff, 0x01,
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  0x00, 0x06, 0x00,
};

static uint8_t block[] = {
  0xff, 0xff, 0x0f,
  0xff, 0xff, 0x0f,
  0xff, 0xff, 0x0f,
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  0xff, 0xff, 0x0f,
};


static uint8_t ball[] = {
  0x00, 0x00, 0x00,
  0x00, 0x00, 0x00,
  0x00, 0x00, 0x00,
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  0x00, 0x00, 0x00,
};

static uint8_t empty[] = {
  0x00, 0x00, 0x00,
  0x00, 0x00, 0x00,
  0x00, 0x00, 0x00,
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  0x00, 0x00, 0x00,
};


static uint8_t test_map1[] = {   // 84 elements
  0x33, 0x33, 0x31, 0x31,
  0x31, 0x31, 0x31, 0x31,
  0x30, 0x31, 0x32, 0x33,
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  0x30, 0x31, 0x32, 0x33,
};


static uint8_t test_map[84];

static uint8_t prev_map[84];


void myMapDisplay(const uint8_t *my_map) {
  Serial.print(my_map[0]);
  int i = 0;
  for (i = 0; i < 84; i++){
    int x = 0;
    int y = 0;
    x = 20 * (i % 12);
    y = 20 * (i / 12);
    if (my_map[i] == 0x30){ u8g2.drawXBM( x, y, mapElement_h, mapElement_w, empty);  }
    else if (my_map[i] == 0x31){ u8g2.drawXBM( x, y, mapElement_h, mapElement_w, ball);  }
    else if (my_map[i] == 0x32){ u8g2.drawXBM( x, y, mapElement_h, mapElement_w, block);  }
    else if (my_map[i] == 0x33){ u8g2.drawXBM( x, y, mapElement_h, mapElement_w, tank1_up); }
    else if (my_map[i] == 0x34){ u8g2.drawXBM( x, y, mapElement_h, mapElement_w, tank1_down);  }
    else if (my_map[i] == 0x35){ u8g2.drawXBM( x, y, mapElement_h, mapElement_w, tank1_left);  }
    else if (my_map[i] == 0x36){ u8g2.drawXBM( x, y, mapElement_h, mapElement_w, tank1_right); }
    else if (my_map[i] == 0x41){ u8g2.drawXBM( x, y, mapElement_h, mapElement_w, tank2_up); }
    else if (my_map[i] == 0x42){ u8g2.drawXBM( x, y, mapElement_h, mapElement_w, tank2_down);  }
    else if (my_map[i] == 0x43){ u8g2.drawXBM( x, y, mapElement_h, mapElement_w, tank2_left);  }
    else if (my_map[i] == 0x44){ u8g2.drawXBM( x, y, mapElement_h, mapElement_w, tank2_right); }
    else { u8g2.drawXBM( x, y, mapElement_h, mapElement_w, empty);  }
    }
}

void displayResult(int i)
{
  //Serial.write(i);
  Serial.print("Result:");
  Serial.print("\n");
  if (i == 0) { u8g2.drawStr(0,0, "DRAW!"); }
  else if (i == 1){ u8g2.drawStr(0,0, "Player 1 WINS!"); }
  else if (i == 2){ u8g2.drawStr(0,0, "Player 2 WINS!"); }
}



/*
void setup(void) {
  u8g2.begin();
  Serial.begin(9600);
  
  Serial.begin(57600);
  while (!Serial) {
    ; // wait for serial port to connect. Needed for native USB port only
  }
  //Serial.println("Goodnight moon!");
  // set the data rate for the SoftwareSerial port
  mySerial.begin(9600);
}

void loop(void) {
  //u8g2.setFontDirection(0);
  //u8g2.clearDisplay();
  
  //u8g2.drawStr(0,0,mySerial.read());


  while (mySerial.available())
  {
    char startStat = mySerial.read();
    Serial.write(startStat);
    if (startStat == 0x38)  // map in
    {
      u8g2.drawStr(0, 0, "1");
      int j = 0;
      for (int j = 0; j < 84; j++)
      {
        test_map[j] = mySerial.read();
      }

      
    }
    else if (startStat == 0x37)  // game state
    {
      if (mySerial.read() == 0x3A) { displayResult(1); }  // play1 wins
      else if (mySerial.read() == 0x3B) { displayResult(2); }  // play2 wins
      else if (mySerial.read() == 0x3C) { displayResult(0); }  // draw
    
    }
  }
  
   
  u8g2.firstPage();
  do {
    u8g2.setDrawColor(1);
    u8g2.setBitmapMode(0);
    u8g2.setFont(u8g2_font_ncenB14_tr);
    u8g2.setFontDirection(0);


    myMapDisplay(test_map);
    
  } while ( u8g2.nextPage() );
}
*/

void setup() {
  u8g2.begin();

  // Open serial communications and wait for port to open:

  Serial.begin(57600);

  while (!Serial) {

    ; // wait for serial port to connect. Needed for native USB port only

  }

  //Serial.println("Goodnight moon!");

  // set the data rate for the SoftwareSerial port

  mySerial.begin(9600);

 for (int i = 0; i < 84; i++)
 {
  prev_map[i] = 0x00;
  }
}



void loop() { // run over and over
  while(!mySerial.available());
  uint8_t StartSignal;
  uint8_t EndSignal;
  StartSignal = mySerial.read();
  Serial.print(StartSignal,HEX);
  
  if(StartSignal == 0x37)  // game state
  {
    Serial.print(StartSignal,HEX);
    uint8_t GameResult = mySerial.read();
    Serial.print(GameResult);
    
    u8g2.clearBuffer();
    u8g2.setDrawColor(1);
    u8g2.setBitmapMode(0);
    u8g2.setFont(u8g2_font_ncenB14_tr);
    u8g2.setFontDirection(0);

    Serial.print("\n"); 
    Serial.print("Result:"); Serial.print(GameResult);
    Serial.print("\n"); 
    if (GameResult == 0x3A) { /*Serial.print(GameResult)*/; u8g2.drawStr(0,0, "Player1 wins!"); /*Serial.print(GameResult);*/}  // play1 wins
    else if (GameResult == 0x3B) { u8g2.drawStr(0,0, "Player2 wins!"); }  // play2 wins
    else if (GameResult == 0x3C) { u8g2.drawStr(0,0, "Draw"); }  // draw
    delay(1000);
    u8g2.sendBuffer();
    
  }
  else if(StartSignal == 0x38)
  {
    int j = 0;
    
    Serial.print(StartSignal,HEX);
    Serial.print("\n");
    /*
    for (int j = 0; j < 84; j++)
    { 
      while(!mySerial.available());
      test_map[j] = mySerial.read();
     
    }
    */
    while(!mySerial.available());
    mySerial.readBytes(test_map,84);
    EndSignal = mySerial.read();
    /*for (int j = 0; j < 84; j++)
    { 
      Serial.print(test_map[j],HEX);
    }*/
    for (int j = 0; j < 7; j++) 
    {
      for (int k = 0; k < 12; k++)
      {
        if (test_map[j*12+k] != 0x30 && test_map[j*12+k] != 0x31 && test_map[j*12+k] != 0x32 && test_map[j*12+k] != 0x33 && test_map[j*12+k] != 0x34 && test_map[j*12+k] != 0x35 && test_map[j*12+k] != 0x36 && test_map[j*12+k] != 0x41 && test_map[j*12+k] != 0x42 && test_map[j*12+k] != 0x43 && test_map[j*12+k] != 0x44 )
        {
          Serial.print(" "); Serial.print("Err:"); Serial.print(test_map[j*12+k], HEX); Serial.print(" ");
        }
        else
        {
          Serial.print(" "); Serial.print("\t"); Serial.print(test_map[j*12+k], HEX); Serial.print(" ");
        }
      }
      Serial.print("\n");
    }
   
    Serial.println(EndSignal);

    /*
     u8g2.firstPage();
    do {
    u8g2.setDrawColor(1);
    u8g2.setBitmapMode(0);
    u8g2.setFont(u8g2_font_ncenB14_tr);
    u8g2.setFontDirection(0);
    //Serial.print(test_map[0]);
    //Serial.print(test_map1[0]);
    //myMapDisplay(test_map);
    if (StartSignal == 0x38) {myMapDisplay(test_map);}
    //if (GameResult == 0x37) {displayResult(GameResult);}
    
    } while ( u8g2.nextPage() );*/

     u8g2.clearBuffer();
     u8g2.setDrawColor(1);
     u8g2.setBitmapMode(0);
     u8g2.setFont(u8g2_font_ncenB14_tr);
     u8g2.setFontDirection(0);
     //u8g2.drawStr(0,20,"Hello World!");
     if (StartSignal == 0x38) {myMapDisplay(test_map);}
     u8g2.sendBuffer();
  
  }
  else if (StartSignal == 0x39)
  {
    Serial.print(StartSignal); Serial.print("\n");
    Serial.print(mySerial.read()); Serial.print(" ");
    Serial.print(mySerial.read()); Serial.print(" ");
    Serial.print(mySerial.read()); Serial.print(" ");
    Serial.print(mySerial.read()); Serial.print("\n");
  }
   else {Serial.print(StartSignal,HEX);}
}
